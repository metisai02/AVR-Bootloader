## ESP_MainBoard/Libs/wifi/Kconfig
```kconfig
menu "Wifi Configuration"

    config ESP_WIFI_SSID
        string "WiFi SSID"
        default "Cloud coffe 2"
        help
            SSID (network name) for the example to connect to.

    config ESP_WIFI_PASSWORD
        string "WiFi Password"
        default "23456789"
        help
            WiFi password (WPA or WPA2) for the example to use.
endmenu
```
